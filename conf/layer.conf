## conf/layer.conf
```bitbake
# We have a conf and classes directory, add to BBPATH
BBPATH .= ":${LAYERDIR}"

# We have a packages directory, add to BBFILES
BBFILES += "${LAYERDIR}/recipes-*/*/*.bb"
BBFILES += "${LAYERDIR}/recipes-*/*/*.bbappend"

BBFILE_COLLECTIONS += "h_da"
BBFILE_PATTERN_h_da = "^${LAYERDIR}/"
BBFILE_PRIORITY_h_da = "5"

LAYERDEPENDS_h_da = "core"
```
